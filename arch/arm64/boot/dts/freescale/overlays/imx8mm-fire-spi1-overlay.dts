/*
 * Copyright (C) 2021 - All Rights Reserved by 
 * filename : imx8mm-fire-spi1-overlay.dts
 * brief : Device Tree overlay for ebf imx8mm spi1 device
 * author : embedfire
 * date : 2022-08-02 
 * version : A001
 */

/dts-v1/;
/plugin/;

#include "../imx8mm-pinfunc.h"
#include "dt-bindings/gpio/gpio.h"
#include "dt-bindings/clock/imx8mm-clock.h"

/ {
	fragment@0 {
		target = <&ecspi1>;
		__overlay__ {
			#address-cells = <1>;
			#size-cells = <0>;
			fsl,spi-num-chipselects = <1>;
			cs-gpios = <&gpio5 9 GPIO_ACTIVE_LOW>;
			pinctrl-names = "default";
			pinctrl-0 = <&pinctrl_ecspi1>;
			status = "okay";

			spidev0: spi@0 {
				reg = <0>;
				compatible = "rohm,dh2228fv";
				status = "okay";
				spi-max-frequency = <5000000>;
			};
			
		};
	};
	
	fragment@1 {
		target= <&iomuxc>;
		__overlay__{
			pinctrl_ecspi1: ecspi1grp {
				fsl,pins = <
					MX8MM_IOMUXC_ECSPI1_MISO_ECSPI1_MISO       0x00000116
					MX8MM_IOMUXC_ECSPI1_MOSI_ECSPI1_MOSI       0x00000116
					MX8MM_IOMUXC_ECSPI1_SCLK_ECSPI1_SCLK       0x00001916
					MX8MM_IOMUXC_ECSPI1_SS0_ECSPI1_SS0         0x00000116
				>;
			};
		};
	};
};


