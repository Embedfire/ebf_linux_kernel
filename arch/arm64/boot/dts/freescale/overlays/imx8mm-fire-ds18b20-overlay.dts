/*
 * Copyright (C) 2021 - All Rights Reserved by 
 * filename : imx8mm-fire-ds18b20-overlay.dts
 * brief : Device Tree overlay for ebf imx8mm ds18b20 device
 * author : embedfire
 * date : 2024-01-12
 * version : A001
 */

/dts-v1/;
/plugin/;

#include "../imx8mm-pinfunc.h"
#include "dt-bindings/gpio/gpio.h"
#include "dt-bindings/clock/imx8mm-clock.h"

/ {


	fragment@0 {
		target = <&iomuxc>;
			__overlay__ { 
				pinctrl_18b20: tempgrp {
				fsl,pins = <
					MX8MM_IOMUXC_GPIO1_IO05_GPIO1_IO5	0x140	
				>;
			}; 
		};
	};    

	fragment@1 {
		target-path = "/";
		__overlay__ {
			ds18b20 {
				#address-cells = <1>;
				#size-cells = <1>;
				pinctrl-names = "default";
				compatible = "fire,temp_ds18b20";
				linux,open-drain;
				pinctrl-0 = <&pinctrl_18b20>;
				ds18b20_pin = <&gpio1 5 GPIO_ACTIVE_HIGH>;	/*ds18b20 pin*/
				status = "okay";
			};
		};
	};
};
