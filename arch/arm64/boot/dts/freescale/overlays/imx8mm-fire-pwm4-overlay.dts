/*
 * Copyright (C) 2021 - All Rights Reserved by 
 * filename : imx8mm-fire-pwm4-overlay.dts
 * brief : Device Tree overlay for ebf imx8mm pwm4 device
 * author : embedfire
 * date : 2021-08-01 
 * version : A001
 */


/dts-v1/;
/plugin/;

#include "../imx8mm-pinfunc.h"
#include "dt-bindings/gpio/gpio.h"
#include "dt-bindings/clock/imx8mm-clock.h"



/ {
	fragment@0 {
		target= <&pwm4>;
        __overlay__{
			pinctrl-names = "default";
		    pinctrl-0 = <&pinctrl_pwm4>;
		    status = "okay";
		};
	};

	fragment@1 {
		target= <&iomuxc>;
		__overlay__{
			pinctrl_pwm4: pwm4grp {
				fsl,pins = <
					MX8MM_IOMUXC_GPIO1_IO15_PWM4_OUT        0x00000116
				>;
			};
		};
	};
};
