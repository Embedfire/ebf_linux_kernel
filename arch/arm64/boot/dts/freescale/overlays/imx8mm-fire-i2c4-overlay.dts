/*
 * Copyright (C) 2021 - All Rights Reserved by 
 * filename : imx8mm-fire-i2c4-overlay.dts
 * brief : Device Tree overlay for ebf imx8mm i2c4 device
 * author : embedfire
 * date : 2021-12-01 
 * version : A001
 */

/dts-v1/;
/plugin/;

#include "../imx8mm-pinfunc.h"
#include "dt-bindings/gpio/gpio.h"
#include "dt-bindings/clock/imx8mm-clock.h"

/ {
	fragment@0 {
		target = <&i2c4>;
		__overlay__ {
			pinctrl-names = "default";
			pinctrl-0 = <&pinctrl_i2c4>;
			clock-frequency = <400000>;
			status = "okay";
		};
	};
	
	fragment@1 {
		target= <&iomuxc>;
		__overlay__{
			pinctrl_i2c4: i2c4grp {
				fsl,pins = <
					MX8MM_IOMUXC_I2C4_SCL_I2C4_SCL           0x400001c3
					MX8MM_IOMUXC_I2C4_SDA_I2C4_SDA           0x400001c3
				>;
			};
		};
	};
};
