/*
 * Copyright (C) 2021 - All Rights Reserved by 
 * filename : imx8mm-fire-i2c1-overlay.dts
 * brief : Device Tree overlay for ebf imx8mm i2c1 device
 * author : embedfire
 * date : 2021-12-01 
 * version : A001
 */

/dts-v1/;
/plugin/;

#include "../imx8mm-pinfunc.h"
#include "dt-bindings/gpio/gpio.h"
#include "dt-bindings/clock/imx8mm-clock.h"

/ {
	fragment@0 {
		target = <&i2c1>;
		__overlay__ {
			pinctrl-names = "default";
			pinctrl-0 = <&pinctrl_i2c1>;
			clock-frequency = <400000>;
			status = "okay";
		};
	};
	
	fragment@1 {
		target= <&iomuxc>;
		__overlay__{
			pinctrl_i2c1: i2c1grp {
				fsl,pins = <
					MX8MM_IOMUXC_I2C1_SCL_I2C1_SCL           0x400001c3
					MX8MM_IOMUXC_I2C1_SDA_I2C1_SDA           0x400001c3
				>;
			};
		};
	};
};
