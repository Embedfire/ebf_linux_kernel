/*
 * Copyright (C) 2019 - All Rights Reserved by 
 * filename : imx-fire-i2c-gpio-overlay.dts
 * brief : Device Tree overlay for EBF6ull Pro mpu6050 device
 * author : embedfire
 * date : 2019-11-26
 * version : A001
 */

/dts-v1/;
/plugin/;
#include <dt-bindings/gpio/gpio.h>
#include "../imx6ul-pinfunc.h"
#include "../imx6ull-pinfunc.h"
/{

	fragment@0{
		target-path="/";
		__overlay__ {
			i2c@0 {
				compatible = "i2c-gpio";
				pinctrl-names = "default";
				pinctrl-0 = <&pinctrl_i2c1>;
				sda-gpios = <&gpio3 0 (GPIO_ACTIVE_HIGH|GPIO_OPEN_DRAIN)>;
				scl-gpios = <&gpio3 1 (GPIO_ACTIVE_HIGH|GPIO_OPEN_DRAIN)>;
				i2c-gpio,delay-us = <2>;	/* ~100 kHz */
				#address-cells = <1>;
				#size-cells = <0>;
			};
		};

	};

   fragment@1{
       target = <&iomuxc>;
       __overlay__ {
          pinctrl_i2c1: i2c1grp {
              fsl,pins = <
                  MX6UL_PAD_LCD_CLK__GPIO3_IO00 0x1b0b0
                  MX6UL_PAD_LCD_ENABLE__GPIO3_IO01 0x1b0b0
              >;
          };           
       };
   };

};
