/*
 * Copyright (C) 2019 - All Rights Reserved by 
 * filename : imx-fire-uart3-overlay.dts
 * brief : Device Tree overlay for EBF6ull uart3 device
 * author : embedfire
 * date : 2019-11-19 
 * version : A001
 */

/dts-v1/;
/plugin/;
#include "../imx6ul-pinfunc.h"
#include "../imx6ull-pinfunc.h"
#include "dt-bindings/gpio/gpio.h"

/ {
	fragment@0 {
		target = <&flexcan2>;	
		__overlay__ {
			pinctrl-names = "default";
			pinctrl-0 = <&pinctrl_flexcan2>;
			
			status = "okay";				
		};
	};
	
	fragment@1 {
		target = <&iomuxc>;
		__overlay__ {
			pinctrl_flexcan2: flexcan2grp{
				fsl,pins = <
					MX6UL_PAD_UART2_RTS_B__FLEXCAN2_RX	0x1b020
					MX6UL_PAD_UART2_CTS_B__FLEXCAN2_TX	0x1b020
				>;
			};
		};
	};

};
