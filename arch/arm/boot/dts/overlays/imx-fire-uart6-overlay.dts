/*
 * Copyright (C) 2019 - All Rights Reserved by 
 * filename : imx-fire-uart6-overlay.dts
 * brief : Device Tree overlay for EBF6ull uart6 device
 * author : embedfire
 * date : 2019-11-19 
 * version : A001
 */
 
/dts-v1/;
/plugin/;
#include "../imx6ul-pinfunc.h"
#include "../imx6ull-pinfunc.h"
#include "dt-bindings/gpio/gpio.h"

 / {
	 fragment@0 {
		target=<&uart6>;
		__overlay__ {
			pinctrl-names = "default";
			pinctrl-0 = <&pinctrl_uart6>;
			status = "okay";            
		};
	 };
	fragment@1 {
		target=<&iomuxc>;
		__overlay__ {
			pinctrl_uart6:uart6grp {
				fsl,pins = <
					MX6UL_PAD_CSI_MCLK__UART6_DCE_TX	0x1b0b1
					MX6UL_PAD_CSI_PIXCLK__UART6_DCE_RX	0x1b0b1                
				>;
			};  
		};
	};
};