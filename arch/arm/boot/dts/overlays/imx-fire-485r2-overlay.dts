/*
 * Copyright (C) 2019 - All Rights Reserved by 
 * filename : imx-fire-485r2-overlay.dts
 * brief : Device Tree overlay for EBF6ull rs485 device
 * author : embedfire
 * date : 2019-12-17 
 * version : A001
 */

/dts-v1/;
/plugin/;
#include "../imx6ul-pinfunc.h"
#include "../imx6ull-pinfunc.h"
#include "dt-bindings/gpio/gpio.h" 



/ {
     fragment@0 {
        target=<&uart3>;
        __overlay__ {
					pinctrl-names = "default";
					pinctrl-0 = <&pinctrl_485r2>;
					/*uart-has-rtscts;
					rts-gpios = <&gpio1 23 GPIO_ACTIVE_HIGH>;*/
					linux,rs485-enabled-at-boot-time;
					status = "okay";           
        };
     };
    fragment@1 {
        target=<&iomuxc>;
        __overlay__ {
					pinctrl_485r2: 485r2grp {
						fsl,pins = <
							MX6UL_PAD_UART3_TX_DATA__UART3_DCE_TX	0x1b0b1
							MX6UL_PAD_UART3_RX_DATA__UART3_DCE_RX	0x1b0b1
							MX6UL_PAD_UART2_RTS_B__GPIO1_IO23	0x1b0b1  /*RS485 RE/DE */
						>;
					};
 
        };
    };
};
