/*
 * Copyright (C) 2019 - All Rights Reserved by 
 * filename : imx-fire-ecspi4-overlay.dts
 * brief : Device Tree overlay for EBF6ull ecspi4' device
 * author : embedfire
 * date : 2019-12-10 
 * version : A001
 */
#include "../imx6ul-pinfunc.h"
#include "../imx6ull-pinfunc.h"
#include "../imx6ull-pinfunc-snvs.h"
#include "dt-bindings/interrupt-controller/irq.h"
#include "dt-bindings/gpio/gpio.h"
/dts-v1/;
/plugin/;

/ {
		fragment@0 {
			target = <&ecspi4>;
			__overlay__ {
				fsl,spi-num-chipselects = <1>;
				cs-gpio = <&gpio1 20 GPIO_ACTIVE_LOW>;
				pinctrl-names = "default";
				pinctrl-0 = <&pinctrl_ecspi4>;
				status = "okay";
				#address-cells = <1>;
				#size-cells = <0>; 
				spidev@0 {
					compatible = "spidev";
					spi-max-frequency = <20000000>;
					reg = <0>;
				};
			};
		};
		
		fragment@1 {
			target = <&iomuxc>;
			__overlay__ {
				pinctrl_ecspi4:ecspi4grp {
					fsl,pins = <
						MX6UL_PAD_ENET2_RX_ER__ECSPI4_SS0			0x1a090
						MX6UL_PAD_ENET2_TX_DATA1__ECSPI4_SCLK		0x11090
						MX6UL_PAD_ENET2_TX_EN__ECSPI4_MOSI			0x11090
						MX6UL_PAD_ENET2_TX_CLK__ECSPI4_MISO			0x11090
					>;
				};
			};
		};

};
