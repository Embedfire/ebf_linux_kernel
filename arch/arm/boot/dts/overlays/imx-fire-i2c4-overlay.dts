/*
 * Copyright (C) 2019 - All Rights Reserved by 
 * filename : imx-fire-mpu6050-overlay.dts
 * brief : Device Tree overlay for EBF6ull Pro mpu6050 device
 * author : embedfire
 * date : 2019-11-26
 * version : A001
 */

 /dts-v1/;
 /plugin/;
#include "../imx6ul-pinfunc.h"
#include "../imx6ull-pinfunc.h"

 / {
	 fragment@0 {
		 target = <&i2c4>;
		 __overlay__ {
		 			clock_frequency = <100000>;
					pinctrl-names = "default";
					pinctrl-0 = <&pinctrl_i2c4>;
					status = "okay";
					#address-cells = <1>;
					#size-cells = <0>;
		 
		 };
	 };

	 fragment@1{
		 target = <&iomuxc>;
		 __overlay__ {
					pinctrl_i2c4: i2c4grp {
						fsl,pins = <
							MX6UL_PAD_LCD_DATA02__I2C4_SDA 0x4001b8b0
							MX6UL_PAD_LCD_DATA03__I2C4_SCL 0x4001b8b0
						>;
					};
		 };
	 };
 };
