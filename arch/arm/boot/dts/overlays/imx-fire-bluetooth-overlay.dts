/*
 * Copyright (C) 2019 - All Rights Reserved by 
 * filename : imx-fire-uart3-overlay.dts
 * brief : Device Tree overlay for EBF6ull uart3 device
 * author : embedfire
 * date : 2019-11-19 
 * version : A001
 */
 
/dts-v1/;
/plugin/;
#include "../imx6ul-pinfunc.h"
#include "../imx6ull-pinfunc.h"
#include "dt-bindings/gpio/gpio.h"

 / {
     fragment@0 {
        target=<&uart2>;
        __overlay__ {
		pinctrl-names = "default";
		fsl,uart-has-rtscts;
		pinctrl-0 = <&pinctrl_uart2dte>;
		status = "okay";         
        };
     };
    fragment@1 {
        target=<&iomuxc>;
        __overlay__ {
            pinctrl_uart2dte:uart2dtegrp {
                fsl,pins = <
			MX6UL_PAD_UART2_TX_DATA__UART2_DCE_TX	0x1b0b1
			MX6UL_PAD_UART2_RX_DATA__UART2_DCE_RX	0x1b0b1
			/*MX6UL_PAD_UART3_RX_DATA__UART2_DCE_RTS	0x1b0b1
			MX6UL_PAD_UART3_TX_DATA__UART2_DCE_CTS	0x1b0b1    pengjie 20190622*/
			MX6UL_PAD_UART2_CTS_B__UART2_DCE_CTS	0x1b0b1
			MX6UL_PAD_UART2_RTS_B__UART2_DCE_RTS	0x1b0b1               
                >;
            };  
        };
    };
};
