/*
 * Copyright (C) 2019 - All Rights Reserved by 
 * filename : imx-fire-74hc595-overlay.dts
 * brief : Device Tree overlay for 74hc595 device
 * author : embedfire
 * date : 2020-03-25 
 * version : A001
 */

#include "../imx6ul-pinfunc.h"
#include "../imx6ull-pinfunc.h"
#include "dt-bindings/gpio/gpio.h"
#include "../imx6ull-pinfunc-snvs.h"
/dts-v1/;
/plugin/;

/ {
	fragment@0 {
		target = <&spi4>;		
		__overlay__ {
			status = "okay";
		};
	};
};
