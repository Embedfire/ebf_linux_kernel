/*
 * Copyright (C) 2019 - All Rights Reserved by 
 * filename : imx-fire-dht11-overlay.dts
 * brief : Device Tree overlay for EBF6ull dht11 device
 * author : embedfire
 * date : 2019-12-14 
 * version : A001
 */
/dts-v1/;
/plugin/;
#include "../imx6ul-pinfunc.h"
#include "../imx6ull-pinfunc.h"
#include "dt-bindings/gpio/gpio.h"
 / {
        fragment@0 {
            target-path = "/";
            __overlay__ {
		dht11{
			compatible = "dht11";
			gpios = <&gpio1 2 GPIO_ACTIVE_LOW>;
			linux,open-drain;
			pinctrl-names = "default";
			pinctrl-0 = <&pinctrl_onewire>;
			status = "okay";
		};
            };
        };

        fragment@1 {
            target= <&iomuxc>;
            __overlay__{
		pinctrl_onewire: onewire {
			fsl,pins = <
				//MX6UL_PAD_GPIO1_IO02__GPIO1_IO02          0x000090B1     DHT11
				MX6UL_PAD_GPIO1_IO02__GPIO1_IO02          0x400138B1
			>;
		};		
            };
        };

 };
