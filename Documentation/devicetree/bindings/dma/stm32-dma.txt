## Documentation/devicetree/bindings/dma/stm32-dma.txt
```
* STMicroelectronics STM32 DMA controller

The STM32 DMA is a general-purpose direct memory access controller capable of
supporting 8 independent DMA channels. Each channel can have up to 8 requests.

Required properties:
- compatible: Should be "st,stm32-dma"
- reg: Should contain DMA registers location and length. This should include
  all of the per-channel registers.
- interrupts: Should contain all of the per-channel DMA interrupts in
  ascending order with respect to the DMA channel index.
- clocks: Should contain the input clock of the DMA instance.
- #dma-cells : Must be <4>. See DMA client paragraph for more details.

Optional properties:
- dma-requests : Number of DMA requests supported.
- resets: Reference to a reset controller asserting the DMA controller
- st,mem2mem: boolean; if defined, it indicates that the controller supports
  memory-to-memory transfer
- dmas: A list of eight dma specifiers, one for each entry in dma-names.
  Refer to stm32-mdma.txt for more details.
- dma-names: should contain "ch0", "ch1", "ch2", "ch3", "ch4", "ch5", "ch6" and
  "ch7" and represents each STM32 DMA channel connected to a STM32 MDMA one.
- memory-region : phandle to a node describing memory to be used for
  M2M intermediate transfer between DMA and MDMA.

Example:

	dma2: dma-controller@40026400 {
		compatible = "st,stm32-dma";
		reg = <0x40026400 0x400>;
		interrupts = <56>,
			     <57>,
			     <58>,
			     <59>,
			     <60>,
			     <68>,
			     <69>,
			     <70>;
		clocks = <&clk_hclk>;
		#dma-cells = <4>;
		st,mem2mem;
		resets = <&rcc 150>;
		dma-requests = <8>;
		dmas = <&mdma1 8 0x10 0x1200000a 0x40026408 0x00000020 1>,
		       <&mdma1 9 0x10 0x1200000a 0x40026408 0x00000800 1>,
		       <&mdma1 10 0x10 0x1200000a 0x40026408 0x00200000 1>,
		       <&mdma1 11 0x10 0x1200000a 0x40026408 0x08000000 1>,
		       <&mdma1 12 0x10 0x1200000a 0x4002640C 0x00000020 1>,
		       <&mdma1 13 0x10 0x1200000a 0x4002640C 0x00000800 1>,
		       <&mdma1 14 0x10 0x1200000a 0x4002640C 0x00200000 1>,
		       <&mdma1 15 0x10 0x1200000a 0x4002640C 0x08000000 1>;
		dma-names = "ch0", "ch1", "ch2", "ch3", "ch4", "ch5", "ch6", "ch7";
		memory-region = <&sram_dmapool>;
	};

* DMA client

DMA clients connected to the STM32 DMA controller must use the format
described in the dma.txt file, using a four-cell specifier for each
channel: a phandle to the DMA controller plus the following four integer cells:

1. The channel id
2. The request line number
3. A 32bit mask specifying the DMA channel configuration which are device
   dependent:
  -bit 9: Peripheral Increment Address
	0x0: no address increment between transfers
	0x1: increment address between transfers
 -bit 10: Memory Increment Address
	0x0: no address increment between transfers
	0x1: increment address between transfers
 -bit 15: Peripheral Increment Offset Size
	0x0: offset size is linked to the peripheral bus width
	0x1: offset size is fixed to 4 (32-bit alignment)
 -bit 16-17: Priority level
	0x0: low
	0x1: medium
	0x2: high
	0x3: very high
4. A bitfield value specifying DMA features which are device dependent:
 -bit 0-1: DMA FIFO threshold selection
	0x0: 1/4 full FIFO
	0x1: 1/2 full FIFO
	0x2: 3/4 full FIFO
	0x3: full FIFO
 -bit 2: Intermediate M2M transfer from/to DDR to/from SRAM throughout MDMA
	0: MDMA not used to generate an intermediate M2M transfer
	1: MDMA used to generate an intermediate M2M transfer.
 -bit 3-4: indicated SRAM Buffer size in (2^order)*PAGE_SIZE.
	Order is given by those 2 bits starting at 0.
	Valid only whether Intermediate M2M transfer is set.
	For cyclic, whether Intermediate M2M transfer is chosen, any value can
	be set: SRAM buffer size will rely on period size and not on this DT
	value.
 -bit 5: DMA direct mode
	0: FIFO mode: with threshold level selectable with bit 0-1
	1: Direct mode: each DMA request immediately initiates a transfer
	   from/to the memory.

Example:

	usart1: serial@40011000 {
		compatible = "st,stm32-uart";
		reg = <0x40011000 0x400>;
		interrupts = <37>;
		clocks = <&clk_pclk2>;
		dmas = <&dma2 2 4 0x10400 0x1>,
		       <&dma2 7 5 0x10200 0x1>;
		dma-names = "rx", "tx";
	};
```

## Documentation/devicetree/bindings/dma/stm32-mdma.txt
```
* STMicroelectronics STM32 MDMA controller

The STM32 MDMA is a general-purpose direct memory access controller capable of
supporting 64 independent DMA channels with 256 HW requests.

Required properties:
- compatible: Should be "st,stm32h7-mdma"
- reg: Should contain MDMA registers location and length. This should include
  all of the per-channel registers.
- interrupts: Should contain the MDMA interrupt.
- clocks: Should contain the input clock of the DMA instance.
- resets: Reference to a reset controller asserting the DMA controller.
- #dma-cells : Must be <6>. See DMA client paragraph for more details.

Optional properties:
- dma-channels: Number of DMA channels supported by the controller.
- dma-requests: Number of DMA request signals supported by the controller.
- st,ahb-addr-masks: Array of u32 mask to list memory devices addressed via
  AHB bus.

Example:

	mdma1: dma@52000000 {
		compatible = "st,stm32h7-mdma";
		reg = <0x52000000 0x1000>;
		interrupts = <122>;
		clocks = <&timer_clk>;
		resets = <&rcc 992>;
		#dma-cells = <6>;
		dma-channels = <16>;
		dma-requests = <32>;
		st,ahb-addr-masks = <0x20000000>, <0x00000000>;
	};

* DMA client

DMA clients connected to the STM32 MDMA controller must use the format
described in the dma.txt file, using a six-cell specifier for each channel:
a phandle to the MDMA controller plus the following six integer cells:

1. The request line number
2. The priority level
	0x0: Low
	0x1: Medium
	0x2: High
	0x3: Very high
3. A 32bit mask specifying the DMA channel configuration
 -bit 0-1: Source increment mode
	0x0: Source address pointer is fixed
	0x2: Source address pointer is incremented after each data transfer
	0x3: Source address pointer is decremented after each data transfer
 -bit 2-3: Destination increment mode
	0x0: Destination address pointer is fixed
	0x2: Destination address pointer is incremented after each data
	transfer
	0x3: Destination address pointer is decremented after each data
	transfer
 -bit 8-9: Source increment offset size
	0x0: byte (8bit)
	0x1: half-word (16bit)
	0x2: word (32bit)
	0x3: double-word (64bit)
 -bit 10-11: Destination increment offset size
	0x0: byte (8bit)
	0x1: half-word (16bit)
	0x2: word (32bit)
	0x3: double-word (64bit)
-bit 25-18: The number of bytes to be transferred in a single transfer
	(min = 1 byte, max = 128 bytes)
-bit 29:28: Trigger Mode
	0x0: Each MDMA request triggers a buffer transfer (max 128 bytes)
	0x1: Each MDMA request triggers a block transfer (max 64K bytes)
	0x2: Each MDMA request triggers a repeated block transfer
	0x3: Each MDMA request triggers a linked list transfer
4. A 32bit value specifying the register to be used to acknowledge the request
   if no HW ack signal is used by the MDMA client
5. A 32bit mask specifying the value to be written to acknowledge the request
   if no HW ack signal is used by the MDMA client
6. A bitfield value specifying if the MDMA client wants to generate M2M
   transfer with HW trigger (1) or not (0). This bitfield should be only
   enabled for M2M transfer triggered by STM32 DMA client. The memory devices
   involved in this kind of transfer are SRAM and DDR.

Example:

	i2c4: i2c@5c002000 {
		compatible = "st,stm32f7-i2c";
		reg = <0x5c002000 0x400>;
		interrupts = <GIC_SPI 95 IRQ_TYPE_NONE>,
			     <GIC_SPI 96 IRQ_TYPE_NONE>;
		clocks = <&clk_hsi>;
		#address-cells = <1>;
		#size-cells = <0>;
		dmas = <&mdma1 36 0x0 0x40008 0x0 0x0 0>,
		       <&mdma1 37 0x0 0x40002 0x0 0x0 0>;
		dma-names = "rx", "tx";
		status = "disabled";
	};
```

## Documentation/devicetree/bindings/iio/timer/stm32-timer-trigger.txt
```
STMicroelectronics STM32 Timers IIO timer bindings

Must be a sub-node of an STM32 Timers device tree node.
See ../mfd/stm32-timers.txt for details about the parent node.

Required parameters:
- compatible:	Must be one of:
		"st,stm32-timer-trigger"
		"st,stm32h7-timer-trigger"
- reg:		Identify trigger hardware block.

Optional properties:
- pinctrl-names: 	Set to "default". An additional "sleep" state can be
			defined to set pins in sleep state when in low power.
- pinctrl-n: 		Phandle(s) pointing to pin configuration node for PWM,
			respectively for "default" and "sleep" states.

Example:
	timers@40010000 {
		#address-cells = <1>;
		#size-cells = <0>;
		compatible = "st,stm32-timers";
		reg = <0x40010000 0x400>;
		clocks = <&rcc 0 160>;
		clock-names = "int";

		timer@0 {
			compatible = "st,stm32-timer-trigger";
			reg = <0>;
			pinctrl-0	= <&tim1_pins>;
			pinctrl-1	= <&tim1_sleep_pins>;
			pinctrl-names	= "default", "sleep";
		};
	};
```

## Documentation/devicetree/bindings/interrupt-controller/st,stm32-exti.txt
```
STM32 External Interrupt Controller

Required properties:

- compatible: Should be:
    "st,stm32-exti"
    "st,stm32h7-exti"
    "st,stm32mp1-exti"
- reg: Specifies base physical address and size of the registers
- interrupt-controller: Indentifies the node as an interrupt controller
- #interrupt-cells: Specifies the number of cells to encode an interrupt
  specifier, shall be 2
- interrupts: interrupts references to primary interrupt controller
  (only needed for exti controller with multiple exti under
  same parent interrupt: st,stm32-exti and st,stm32h7-exti)

Optional properties:

- hwlocks: reference to a phandle of a hardware spinlock provider node.

Exti could have several parent interrupt controllers. In this case child nodes
are used to describe those "extra" parent controllers. Properties to use are:

- interrupt-controller: Indentifies the node as an interrupt controller
- #interrupt-cells: Specifies the number of cells to encode an interrupt
  specifier, shall be 2
- interrupt-parent: Phandle to the interrupt parent node.
- st,irq-number: Interrupt number mapped on the parent.

See example 2.


Example 1:

exti: interrupt-controller@40013c00 {
	compatible = "st,stm32-exti";
	interrupt-controller;
	#interrupt-cells = <2>;
	reg = <0x40013C00 0x400>;
	interrupts = <1>, <2>, <3>, <6>, <7>, <8>, <9>, <10>, <23>, <40>, <41>, <42>, <62>, <76>;
};

Example 2:

exti: interrupt-controller@5000d000 {
	compatible = "st,stm32mp1-exti", "syscon";
	interrupt-controller;
	#interrupt-cells = <2>;
	reg = <0x5000d000 0x400>;

	exti_pwr: exti-pwr {
		interrupt-controller;
		#interrupt-cells = <2>;
		interrupt-parent = <&pwr>;
		st,irq-number = <6>;
	};
};
```

## Documentation/devicetree/bindings/perf/stm32-ddr-pmu.txt
```
* STM32 DDR Performance Monitor (DDRPERFM)

Required properties:
- compatible: must be "st,stm32-ddr-pmu".
- reg: physical address and length of the registers set.
- clocks: list of phandles and specifiers to all input clocks listed in
	  clock-names property.
- clock-names: "bus" corresponds to the DDRPERFM bus clock and "ddr" to
	       the DDR frequency.

Example:
	ddrperfm: perf@5a007000 {
		compatible = "st,stm32-ddr-pmu";
		reg = <0x5a007000 0x400>;
		clocks = <&rcc DDRPERFM>, <&rcc PLL2_R>;
		clock-names = "bus", "ddr";
	};
```

## Documentation/devicetree/bindings/regulator/st,stm32mp1-pwr-reg.txt
```
STM32MP1 POWER Regulators
-------------------------

Required properties:
- compatible: Must be "st,stm32mp1,pwr-reg"
- list of child nodes that specify the regulator
  initialization data for defined regulators. The definition for each of
  these nodes is defined using the standard binding for regulators found at
  Documentation/devicetree/bindings/regulator/regulator.txt.
- st,tzcr: syscon of Trust Zone Configuration Register. Usefull to know if we
  are in secure mode.
  st,tzcr = &<phandle> <offset> <mask>;
Optional properties:
- vdd-supply: phandle to the parent supply/regulator node for vdd input
- vdd_3v3_usbfs-supply: phandle to the parent supply/regulator node for usb33

Example:

	pwr-regulators@c {
		compatible = "st,stm32mp1,pwr-reg";
		st,tzcr = <&rcc 0x0 0x1>;
		vdd-supply = <&vdd>;
		vdd_3v3_usbfs-supply = <&vdd_usb>;

		reg11: reg11 {
			regulator-name = "reg11";
			regulator-min-microvolt = <1100000>;
			regulator-max-microvolt = <1100000>;
		};

		reg18: reg18 {
			regulator-name = "reg18";
			regulator-min-microvolt = <1800000>;
			regulator-max-microvolt = <1800000>;
		};

		usb33: usb33 {
			regulator-name = "usb33";
			regulator-min-microvolt = <3300000>;
			regulator-max-microvolt = <3300000>;
		};
	};
```
